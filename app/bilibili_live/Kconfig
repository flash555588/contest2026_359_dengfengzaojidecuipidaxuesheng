## app/bilibili_live/Kconfig
```kconfig
config SYSTEM_BILIBILI_LIVE
	bool "Bilibili direct live video (LVGL / OpenH264)"
	default n
	depends on SYSTEM_DESKTOP && NET_TCP && HAVE_CXX && LIBM
	select NETUTILS_CJSON
	select LIBC_NETDB
	select NET_SOCKOPTS
	select PTHREAD_MUTEX_TYPES
	---help---
		Direct HTTPS API and HTTP(S)-FLV playback without a relay server.
		Supports H.264 video and AAC-LC audio. Uses desktop glass_https.
		Install pinned dependencies with tools/install_bilibili_live.py first.
```

## app/espdl-quickapp/overlay/apps/system/hass/Kconfig
```kconfig
# SPDX-License-Identifier: Apache-2.0
config SYSTEM_HASS
  bool "Shared Home Assistant native service"
  default n
  depends on BUILD_FLAT && NET_TCP && !DISABLE_PTHREAD
  help
    Shared in-process API with per-client results, plus 'hass status'.
    HTTP only. Not an IPC daemon or a credential vault.
```

## diagnostics/ble-baseline/apps/system/c6ble/Kconfig
```kconfig
config SYSTEM_C6BLE_V3_EXPERIMENTAL
	bool "Experimental v3 C6 BLE HCI transport"
	default n
	depends on ARCH_CHIP_ESP32P4 && !ESP32P4_SELECTS_REV_LESS_V3
	depends on SYSTEM_C6PROBE=y && NET_BLUETOOTH && !DISABLE_PTHREAD
	depends on !WIRELESS_BLUETOOTH_HOST
	---help---
		Requires the matching HCI ownership patch. Register with c6ble register.
		Prepare Hosted before opening HCI; do not reset it while HCI is open.
		Registers raw HCI networking for the Apache NimBLE socket transport.
		This transport alone does not provide a BLE host or GATT services.
```

## v3/20260915/source/apps/ha_panel/Kconfig
```kconfig
#
# For a description of the syntax of this configuration file,
# see the file kconfig-language.txt in the NuttX tools repository.
#

menuconfig HA_PANEL
	bool "Home Assistant LVGL control panel"
	default n
	depends on GRAPHICS_LVGL
	depends on NET
	depends on NET_TCP
	select NETUTILS_CJSON
	select LV_USE_ARC
	select LV_USE_BUTTON
	select LV_USE_BUTTONMATRIX
	select LV_USE_KEYBOARD
	select LV_USE_LABEL
	select LV_USE_SLIDER
	select LV_USE_SWITCH
	select LV_USE_TEXTAREA
	select LV_USE_TABVIEW
	select LV_USE_THEME_DEFAULT
	select LV_USE_FLEX
	---help---
		Enable the ha_panel application: an LVGL based Home Assistant
		dashboard for openvela.  The UI follows the official LVGL
		widgets / tabview / flex / switch / slider / arc / keyboard
		examples.  It talks to a Home Assistant instance over its
		WebSocket API (ws://<host>:8123/api/websocket), shows lights /
		switches / sensors / climate entities on a card dashboard and
		can control devices, run Home Assistant scenes (movie / night /
		leave / arrive / reading) and filter devices by room.  A long
		lived access token must be created
		in the Home Assistant web UI (Profile -> Security -> Long-Lived
		Access Tokens).  With an empty token the panel starts in demo
		mode so the UI can be exercised without a server.

		nsh> ha_panel
		nsh> ha_panel -s 192.168.1.50 -p 8123 -t <token>

if HA_PANEL

config HA_PANEL_PROGNAME
	string "ha_panel program name"
	default "ha_panel"
	---help---
		This is the name of the program that will be used when the NSH
		program is installed.

config HA_PANEL_PRIORITY
	int "ha_panel UI task priority"
	default 110

config HA_PANEL_STACKSIZE
	int "ha_panel UI task stack size"
	default 24576

config HA_PANEL_NET_PRIORITY
	int "ha_panel network worker task priority"
	default 100

config HA_PANEL_NET_STACKSIZE
	int "ha_panel network worker task stack size"
	default 16384

config HA_PANEL_SERVER_DEFAULT
	string "Default Home Assistant server address"
	default "192.168.1.100"
	---help---
		Used when neither /data/ha_panel.conf nor the command line
		provides a server address.

config HA_PANEL_PORT_DEFAULT
	int "Default Home Assistant port"
	default 8123

config HA_PANEL_TOKEN_DEFAULT
	string "Default long lived access token"
	default ""

config HA_PANEL_CONF_PATH
	string "Primary configuration file path"
	default "/data/ha_panel.conf"

config HA_PANEL_CONF_PATH_ALT
	string "Fallback configuration file path"
	default "/mnt/smartfs/ha_panel.conf"

config HA_PANEL_MAX_ENTITIES
	int "Maximum number of tracked entities"
	default 64

config HA_PANEL_WS_RX_MAX
	int "Maximum WebSocket message size in bytes"
	default 262144
	---help---
		get_states() replies of large Home Assistant instances can
		exceed 100 KB.  Increase this value if the panel reports
		oversized messages.

config HA_PANEL_TTF_CJK
	string "Optional CJK TrueType font for entity names"
	default "/data/ha_cjk.ttf"
	---help---
		If this file exists at start-up it is loaded with tiny_ttf so
		Chinese entity names and the Chinese UI can be rendered.
		Otherwise the UI falls back to the built-in Montserrat fonts
		and English labels.

endif
```

## v3/20260915/source/apps/system/espclaw/Kconfig
```kconfig
# SPDX-License-Identifier: Apache-2.0
config SYSTEM_ESPCLAW
	bool "ESP-Claw offline core selftest"
	default n
	depends on !DISABLE_PTHREAD && BUILD_FLAT
	depends on NET && NET_TCP && LIBC_NETDB
	depends on NETUTILS_CJSON && NETUTILS_WEBCLIENT
	select PTHREAD_MUTEX_TYPES
	help
		Register espclaw selftest. Requires separately linked mbedTLS 4
		and TF-PSA libraries; this does not enable online chat or Lua.

if SYSTEM_ESPCLAW
config SYSTEM_ESPCLAW_PRIORITY
	int "Command priority"
	default 100
config SYSTEM_ESPCLAW_STACKSIZE
	int "Command stack size"
	default 8192
endif
```
